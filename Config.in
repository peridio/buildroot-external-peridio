## board/qemu/aarch64-virt/uboot.defconfig
```kconfig
CONFIG_ARM=y
CONFIG_POSITION_INDEPENDENT=y
CONFIG_ARCH_QEMU=y
CONFIG_SYS_MALLOC_LEN=0x1000000
CONFIG_NR_DRAM_BANKS=1
CONFIG_ENV_SIZE=0x20000
CONFIG_ENV_OFFSET=0x8000
CONFIG_DEFAULT_DEVICE_TREE="qemu-arm64"
CONFIG_DEBUG_UART_BASE=0x9000000
CONFIG_DEBUG_UART_CLOCK=0
CONFIG_SYS_LOAD_ADDR=0x40200000
CONFIG_DEBUG_UART=y
CONFIG_AHCI=y
CONFIG_DISTRO_DEFAULTS=y
CONFIG_USE_PREBOOT=y
# CONFIG_DISPLAY_CPUINFO is not set
# CONFIG_DISPLAY_BOARDINFO is not set
CONFIG_EVENT_DYNAMIC=y
CONFIG_PCI_INIT_R=y
CONFIG_CMD_STRINGS=y
CONFIG_CMD_MBR=y
CONFIG_CMD_MTD=y
CONFIG_CMD_PCI=y
CONFIG_CMD_POWEROFF=y
CONFIG_CMD_READ=y
CONFIG_CMD_USB=y
CONFIG_CMD_TPM=y
CONFIG_CMD_MTDPARTS=y
CONFIG_ENV_IS_IN_MMC=y
CONFIG_DM_EVENT=y
CONFIG_SCSI_AHCI=y
CONFIG_AHCI_PCI=y
CONFIG_MMC_PCI=y
CONFIG_MMC_SDHCI=y
CONFIG_MTD=y
CONFIG_DM_MTD=y
CONFIG_MTD_NOR_FLASH=y
CONFIG_CFI_FLASH=y
CONFIG_CFI_FLASH_USE_WEAK_ACCESSORS=y
CONFIG_SYS_FLASH_USE_BUFFER_WRITE=y
CONFIG_FLASH_CFI_MTD=y
CONFIG_SYS_FLASH_CFI=y
CONFIG_SYS_MAX_FLASH_BANKS=2
CONFIG_SYS_MAX_FLASH_BANKS_DETECT=y
CONFIG_DM_ETH=y
CONFIG_E1000=y
CONFIG_NVME_PCI=y
CONFIG_PCI=y
CONFIG_PCIE_ECAM_GENERIC=y
CONFIG_SCSI=y
CONFIG_DM_SCSI=y
CONFIG_DEBUG_UART_PL011=y
CONFIG_DEBUG_UART_SHIFT=2
CONFIG_SYSRESET=y
CONFIG_SYSRESET_PSCI=y
CONFIG_TPM2_MMIO=y
CONFIG_USB=y
CONFIG_USB_EHCI_HCD=y
CONFIG_USB_EHCI_PCI=y
CONFIG_FAT_WRITE=y
CONFIG_FS_SQUASHFS=y
CONFIG_TPM=y
CONFIG_SHA1=y
CONFIG_SHA256=y
CONFIG_SHA384=y
CONFIG_MD5=y
CONFIG_HEXDUMP=y
CONFIG_SMBIOS_PARSER=y
# CONFIG_EFI_LOADER is not set
```

## configs/peridio_qemu_aarch64_virt_defconfig
```kconfig
BR2_aarch64=y
BR2_GLOBAL_PATCH_DIR="$(BR2_EXTERNAL_PERIDIO_PATH)/patches"
BR2_TOOLCHAIN_BUILDROOT_GLIBC=y
BR2_PACKAGE_HOST_LINUX_HEADERS_CUSTOM_5_15=y
BR2_INIT_SYSTEMD=y
BR2_SYSTEM_DHCP="eth0"
BR2_SYSTEM_DEFAULT_PATH="/bin:/sbin:/usr/bin:/usr/sbin"
BR2_ROOTFS_OVERLAY="$(BR2_EXTERNAL_PERIDIO_PATH)/board/qemu/aarch64-virt/rootfs-overlay"
BR2_ROOTFS_POST_IMAGE_SCRIPT="$(BR2_EXTERNAL_PERIDIO_PATH)/board/qemu/aarch64-virt/post-image.sh"
BR2_ROOTFS_POST_SCRIPT_ARGS="$(BR2_DEFCONFIG)"
BR2_LINUX_KERNEL=y
BR2_LINUX_KERNEL_CUSTOM_VERSION=y
BR2_LINUX_KERNEL_CUSTOM_VERSION_VALUE="5.15.18"
BR2_LINUX_KERNEL_USE_CUSTOM_CONFIG=y
BR2_LINUX_KERNEL_CUSTOM_CONFIG_FILE="$(BR2_EXTERNAL_PERIDIO_PATH)/board/qemu/aarch64-virt/linux.config"
BR2_LINUX_KERNEL_INSTALL_TARGET=y
BR2_LINUX_KERNEL_NEEDS_HOST_OPENSSL=y
BR2_PACKAGE_F2FS_TOOLS=y
BR2_PACKAGE_FWUP=y
BR2_PACKAGE_LIBMNL=y
BR2_PACKAGE_NCURSES=y
BR2_TARGET_ROOTFS_SQUASHFS=y
# BR2_TARGET_ROOTFS_TAR is not set
BR2_TARGET_UBOOT=y
BR2_TARGET_UBOOT_BUILD_SYSTEM_KCONFIG=y
BR2_TARGET_UBOOT_CUSTOM_VERSION=y
BR2_TARGET_UBOOT_CUSTOM_VERSION_VALUE="2022.07"
BR2_TARGET_UBOOT_USE_CUSTOM_CONFIG=y
BR2_TARGET_UBOOT_CUSTOM_CONFIG_FILE="$(BR2_EXTERNAL_PERIDIO_PATH)/board/qemu/aarch64-virt/uboot.defconfig"
BR2_PACKAGE_HOST_DTC=y
BR2_PACKAGE_HOST_FWUP=y
BR2_PACKAGE_HOST_QEMU=y
BR2_PACKAGE_HOST_QEMU_SYSTEM_MODE=y
BR2_PACKAGE_HOST_UBOOT_TOOLS=y
BR2_PACKAGE_HOST_UBOOT_TOOLS_ENVIMAGE=y
BR2_PACKAGE_HOST_UBOOT_TOOLS_ENVIMAGE_SOURCE="$(BR2_EXTERNAL_PERIDIO_PATH)/board/qemu/aarch64-virt/uboot.env"
BR2_PACKAGE_HOST_UBOOT_TOOLS_ENVIMAGE_SIZE="0x20000"
BR2_PACKAGE_PERIDIOD=y
```

## package/peridio/peridio-erlang/Config.in
```kconfig
comment "peridio erlang needs a toolchain w/ dynamic library, threads"
	depends on BR2_USE_MMU # fork()
	depends on BR2_PACKAGE_ERLANG_ARCH_SUPPORTS
	depends on BR2_STATIC_LIBS || !BR2_TOOLCHAIN_HAS_THREADS

config BR2_PACKAGE_PERIDIO_ERLANG
	bool "peridio erlang"
	depends on BR2_USE_MMU # fork()
	depends on !BR2_STATIC_LIBS
	depends on BR2_TOOLCHAIN_HAS_THREADS
	depends on BR2_PACKAGE_ERLANG_ARCH_SUPPORTS
	select BR2_PACKAGE_OPENSSL
	select BR2_PACKAGE_ZLIB
	help
    http://github.com/peridio/buildroot-external-peridio
```

## package/peridio/peridiod/Config.in
```kconfig
config BR2_PACKAGE_PERIDIOD
        bool "peridio daemon"
        select BR2_PACKAGE_FWUP
        select BR2_PACKAGE_ERLANG
        select BR2_PACKAGE_LIBMNL
        help
          http://github.com/peridio/buildroot-external-peridio
```
